## coolpad/drivers/input/fingerprint/Kconfig
```kconfig
config INPUT_FINGERPRINT
	bool "Yulong fingerprint compatibility"
	default n

config GOODIX_GW9558_FINGERPRINT
	bool "Goodix GW9558 fingerprint compatibility"
	depends on INPUT_FINGERPRINT
	default n
```

## coolpad/drivers/input/touchscreen/Kconfig
```kconfig
config YL_TOUCHSCREEN_HAL
	bool "Yulong touchscreen HAL compatibility"
	default n

config YL_TOUCHSCREEN_FT3518
	bool "Yulong FT3518 compatibility"
	default n
```

## coolpad/drivers/misc/Kconfig
```kconfig
config BOOTREASON
	bool "Yulong boot reason compatibility"
	default n

config YL_PSTORE_SSR_REASON
	bool "Yulong SSR reason compatibility"
	default n

config YL_RESERVED_RAM
	bool "Yulong reserved RAM compatibility"
	default n

config YL_RESERVED_RAM_BASE
	hex "Yulong reserved RAM base"
	depends on YL_RESERVED_RAM
	default 0x9b800000

config OEMINFO
	bool "Yulong OEM info compatibility"
	default n

config OEMINFO_DEV_BLK_PATH
	string "Yulong OEM info block path"
	depends on OEMINFO
	default "/dev/block/by-name/params"

config OEMINFO_DEV_BLK_SIZE
	int "Yulong OEM info block size"
	depends on OEMINFO
	default 4096
```

## coolpad/drivers/pixelworks/Kconfig
```kconfig
config PXLW_IRIS3
	bool "Pixelworks Iris3 compatibility"
	default n

config PXLW_IRIS3_PLATFORM_7250
	bool "Pixelworks Iris3 SM7250 compatibility"
	depends on PXLW_IRIS3
	default n

config PXLW_IRIS3_RECOVERY_ABYP
	bool "Lock Iris3 in analog bypass for recovery bring-up"
	depends on PXLW_IRIS3
	default y
	help
	  Keep the first 3917JR recovery candidate in analog bypass mode and
	  suppress Iris debugfs control surfaces that can switch into PT or write
	  product-specific registers. Disable only after the ABYP boot path has
	  been proven stable and the 3917JR PT/HBM/FOD paths are reconstructed.

config PXLW_IRIS3_TCL_CALIBRATION
	bool "Enable TCL panel OTP/MCF calibration path"
	depends on PXLW_IRIS3
	default n
	help
	  Enable only for a product that supplies the matching TCL panel OTP
	  reader and MCF CRC implementation.  This must remain disabled for
	  the 3917JR ABYP recovery candidate.

config PXLW_IRIS3_TCL_BACKLIGHT
	bool "Enable TCL product backlight and HBM coupling"
	depends on PXLW_IRIS3
	default n
	help
	  Enable only with the matching TCL HBM globals and panel command
	  implementation.  The 3917JR recovery candidate keeps the platform
	  panel backlight path instead.
```

## coolpad/drivers/power/Kconfig
```kconfig
config YL_POWER_RESET
	bool "Yulong power reset compatibility"
	default n

config YL_REBOOT_STRESS_TEST
	bool "Yulong reboot stress compatibility"
	default n

config YL_DLOAD_MODE
	bool "Yulong download mode compatibility"
	default n
```

## coolpad/sound/soc/Kconfig
```kconfig
config SND_SOC_PA_CAL
	bool "Yulong speaker amplifier calibration compatibility"
	default n
```

## drivers/input/touchscreen/focaltech_touch/Kconfig
```kconfig
# SPDX-License-Identifier: GPL-2.0-only
#
# Focaltech Touchscreen driver configuration
#

config TOUCHSCREEN_FTS
	bool "Focaltech Touchscreen"
	help
	  Say Y here if you have Focaltech touch panel.
	  If unsure, say N.

# Stock 3917JR defconfig names the built-in driver this way. Keep the
# public GPL driver's existing symbol as the single build switch.
config YL_TOUCHSCREEN_FT3518
	bool "Yulong FT3518 touchscreen"
	select TOUCHSCREEN_FTS
	help
	  Compatibility symbol for the 3917JR stock configuration.

config TOUCHSCREEN_FTS_FW_UPDATE
	bool "Allow FocalTech firmware and LIC writes"
	depends on TOUCHSCREEN_FTS
	default n
	help
	  Enable only after the FT3518 probe, IRQ and touch reporting have been
	  validated. Keeping this disabled is the first-round flash-read-only
	  bring-up mode: no automatic upgrade worker is started and no generic
	  register/upgrade debug nodes are exposed.

config TOUCHSCREEN_FTS_DIRECTORY
	string "Focaltech ts directory name"
	default "focaltech_touch"
	depends on TOUCHSCREEN_FTS
```

## msm-4.19/coolpad/arch/product_list/Kconfig
```kconfig
menu "Yulong product compatibility"

config YULONG_PRODUCT
	bool "Yulong product support"
	default y

config BOARD_GAEA
	bool "Yulong gaea (3917JR)"
	default y

endmenu
```

## msm-4.19/coolpad/drivers/input/misc/Kconfig
```kconfig
config YL_PMIC_INPUT_LOGGING
	bool "Yulong PMIC input logging compatibility"
	default n
```

## msm-4.19/coolpad/drivers/nfc/Kconfig
```kconfig
config YL_NFC_NXP_SN100F
	bool "Yulong NXP SN100F compatibility"
	default n

config YL_NFC_PN553_DEVICES
	bool "Yulong PN553 compatibility"
	default n

config YL_NFC_PN54X_DEVICES
	bool "Yulong PN54x compatibility"
	default n
```

## msm-4.19/coolpad/drivers/pixelworks/Kconfig
```kconfig
config PXLW_IRIS3
	bool "Pixelworks Iris3 compatibility"
	default n

config PXLW_IRIS3_PLATFORM_7250
	bool "Pixelworks Iris3 SM7250 compatibility"
	depends on PXLW_IRIS3
	default n
```
